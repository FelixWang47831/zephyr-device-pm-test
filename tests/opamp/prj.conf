## CMakeLists.txt
```
# Copyright 2026 NXP
# SPDX-License-Identifier: Apache-2.0

cmake_minimum_required(VERSION 3.20.0)

# Pulls in this repository as a Zephyr module, which is what makes lib/pm_test,
# include/pm_test and the snippets/pm-* snippets available. Nothing has to be
# passed on the command line: `-S pm-<layer>` is the whole interface.
list(APPEND EXTRA_ZEPHYR_MODULES ${CMAKE_CURRENT_LIST_DIR}/../..)

find_package(Zephyr REQUIRED HINTS $ENV{ZEPHYR_BASE})
project(opamp_device_pm)

# The suite, the register view, and the control test that every layer runs.
target_sources(app PRIVATE src/main.c src/opamp.c src/test_control.c)

# One file per layer. A layer's file is the only place that layer's claims live,
# so a build for a layer contains no code belonging to any other.
target_sources_ifdef(CONFIG_PM_TEST_LAYER_DEVICE     app PRIVATE src/test_device.c)
target_sources_ifdef(CONFIG_PM_TEST_LAYER_RUNTIME    app PRIVATE src/test_runtime.c)
target_sources_ifdef(CONFIG_PM_TEST_LAYER_SYSTEM     app PRIVATE src/test_system.c)
target_sources_ifdef(CONFIG_PM_TEST_LAYER_SYSMANAGED app PRIVATE src/test_lowpower.c)
target_sources_ifdef(CONFIG_PM_TEST_LAYER_DPD        app PRIVATE src/test_lowpower.c)
```

## prj.conf
```kconfig
# Copyright 2026 NXP
# SPDX-License-Identifier: Apache-2.0
#
# Layer-independent configuration only. The PM symbols come from the layer, which
# comes from the pm-* snippet; see lib/pm_test/Kconfig and docs/pm-layers.md.

CONFIG_ZTEST=y
CONFIG_PM_TEST=y

CONFIG_OPAMP=y

# Driver logging at info level, immediate: the run ends with interrupts locked so
# that the core cannot park in WFI, and a deferred log would never be flushed.
# include/pm_test/layer.h asserts this pairing.
CONFIG_LOG=y
CONFIG_LOG_MODE_IMMEDIATE=y
CONFIG_OPAMP_LOG_LEVEL_INF=y
```

## constraints.overlay
```dts
/*
 * Copyright 2026 NXP
 * SPDX-License-Identifier: Apache-2.0
 */

/*
 * States that cut the opamp's analog bias and therefore its output, cited against
 * each family's reference manual:
 *
 *   MCXA (frdm_mcxa156):           MCXAP100M96FS6RM Rev. 7, section 23.5, p.829
 *   MCXA (frdm_mcxa344):           MCXAP100M180F40RM Rev. 1, section 24.5, p.826
 *   MCXA (frdm_mcxa346/366):       MCXAP144M180FS6RM Rev. 1, section 24.5, p.973
 *   MCXN (frdm_mcxn947):           MCXNX4XRM Rev. 6_RC2, Table 336, p.1323
 *
 * All four agree: the analog core is Optional/On-Off (left to software) in Sleep
 * and Deep Sleep, and only forced Off in Power Down and Deep Power Down -- the SoC
 * dtsi for every board here declares the same two states on &opamp0, so this just
 * restates that list rather than adding to it.
 */

&opamp0 {
	zephyr,disabling-power-states = <&powerdown &deeppowerdown>;
};
```

## boards/frdm_mcxa156.overlay
```dts
/*
 * Copyright 2026 NXP
 * SPDX-License-Identifier: Apache-2.0
 *
 * OPAMP setup for the device-PM test on FRDM-MCXA156.
 *
 * The board already wires &opamp0 with status "okay" and a pinctrl state; this
 * overlay only adds what the test needs on top of that.
 *
 * opamp0 is a gain-capable nxp,opamp. Its SoC dtsi defaults functional-mode to
 * "follower", and mcux_opamp_apply_gain()'s FOLLOWER case ignores the gain index
 * entirely -- a gain-restore assertion would pass without set_gain() having
 * written anything gain-index-dependent. Switching to non_inverting makes the
 * written NGAIN/PGAIN fields actually depend on the requested gain, and setting
 * non-inverting-reference gives mcux_opamp_configure() a nonzero PREF value
 * instead of the UINT8_MAX default, so the "clobber actually changed something"
 * check in src/test_device.c has a nonzero devicetree configuration to clobber.
 */

/ {
	aliases {
		test-opamp = &opamp0;
	};
};

&opamp0 {
	functional-mode = "non_inverting";
	non-inverting-reference = "Input1";
};
```

## boards/frdm_mcxa344.overlay
```dts
/*
 * Copyright 2026 NXP
 * SPDX-License-Identifier: Apache-2.0
 *
 * OPAMP setup for the device-PM test on FRDM-MCXA344.
 *
 * The board already wires &opamp0 with status "okay" and a pinctrl state; this
 * overlay only adds what the test needs on top of that.
 *
 * opamp0 is the fast variant (nxp,opamp-fast): bias-current and
 * compensation-capcitor both default to 0, so mcux_opamp_fast_configure() would
 * write an all-zero OPAMP_CTRL configuration region. src/test_device.c's
 * "clobber actually changed something" check needs a nonzero configuration to
 * clobber, so both are forced to a nonzero value here.
 */

/ {
	aliases {
		test-opamp = &opamp0;
	};
};

&opamp0 {
	bias-current = <1>;
	compensation-capcitor = <1>;
};
```

## boards/frdm_mcxa346.overlay
```dts
/*
 * Copyright 2026 NXP
 * SPDX-License-Identifier: Apache-2.0
 *
 * OPAMP setup for the device-PM test on FRDM-MCXA346.
 *
 * The board already wires &opamp0 with status "okay" and a pinctrl state; this
 * overlay only adds what the test needs on top of that.
 *
 * opamp0 is the fast variant (nxp,opamp-fast): bias-current and
 * compensation-capcitor both default to 0, so mcux_opamp_fast_configure() would
 * write an all-zero OPAMP_CTRL configuration region. src/test_device.c's
 * "clobber actually changed something" check needs a nonzero configuration to
 * clobber, so both are forced to a nonzero value here.
 */

/ {
	aliases {
		test-opamp = &opamp0;
	};
};

&opamp0 {
	bias-current = <1>;
	compensation-capcitor = <1>;
};
```

## boards/frdm_mcxa366.overlay
```dts
/*
 * Copyright 2026 NXP
 * SPDX-License-Identifier: Apache-2.0
 *
 * OPAMP setup for the device-PM test on FRDM-MCXA366.
 *
 * The board already wires &opamp0 with status "okay" and a pinctrl state; this
 * overlay only adds what the test needs on top of that.
 *
 * opamp0 is the fast variant (nxp,opamp-fast): bias-current and
 * compensation-capcitor both default to 0, so mcux_opamp_fast_configure() would
 * write an all-zero OPAMP_CTRL configuration region. src/test_device.c's
 * "clobber actually changed something" check needs a nonzero configuration to
 * clobber, so both are forced to a nonzero value here.
 */

/ {
	aliases {
		test-opamp = &opamp0;
	};
};

&opamp0 {
	bias-current = <1>;
	compensation-capcitor = <1>;
};
```

## boards/frdm_mcxn947_mcxn947_cpu0.overlay
```dts
/*
 * Copyright 2026 NXP
 * SPDX-License-Identifier: Apache-2.0
 *
 * OPAMP setup for the device-PM test on FRDM-MCXN947 (cpu0).
 *
 * The board already wires &opamp0 with status "okay" and a pinctrl state; this
 * overlay only adds what the test needs on top of that.
 *
 * opamp0 is a gain-capable nxp,opamp. Its SoC dtsi defaults functional-mode to
 * "follower", and mcux_opamp_apply_gain()'s FOLLOWER case ignores the gain index
 * entirely -- a gain-restore assertion would pass without set_gain() having
 * written anything gain-index-dependent. Switching to non_inverting makes the
 * written NGAIN/PGAIN fields actually depend on the requested gain, and setting
 * non-inverting-reference gives mcux_opamp_configure() a nonzero PREF value
 * instead of the UINT8_MAX default, so the "clobber actually changed something"
 * check in src/test_device.c has a nonzero devicetree configuration to clobber.
 *
 * This is also the only board in scope that completes the dpd layer --
 * mcxa-suspend-to-idle-never-wakes in docs/findings.md means dpd is expected to
 * block on every MCXA board here -- so this overlay is what proves the RESUME
 * gain-replay fix across a real power cycle, not just a synthetic TURN_ON/RESUME
 * pair under the device layer.
 */

/ {
	aliases {
		test-opamp = &opamp0;
	};
};

&opamp0 {
	functional-mode = "non_inverting";
	non-inverting-reference = "Input1";
};
```

## src/main.c
```c
/*
 * Copyright 2026 NXP
 * SPDX-License-Identifier: Apache-2.0
 */

/**
 * @file
 * @brief OPAMP device-PM suite: the suite hooks, and nothing else.
 *
 * Which layer this build tests, and therefore which src/test_*.c is compiled in,
 * is decided by the pm-* snippet on the command line. See docs/pm-layers.md.
 */

#include <zephyr/ztest.h>

#include <pm_test/layer.h>
#include <pm_test/state.h>

#include "opamp.h"

static void *opamp_pm_setup(void)
{
	(void)pm_test_setup();
	pm_test_note_state(OPAMP_DEV, "at boot");
	opamp_report_hw("at boot");
	return NULL;
}

static void opamp_pm_before(void *fixture)
{
	ARG_UNUSED(fixture);

	zassert_true(device_is_ready(OPAMP_DEV), "%s is not ready", OPAMP_DEV->name);
}

ZTEST_SUITE(opamp_pm, NULL, opamp_pm_setup, opamp_pm_before, NULL, NULL);
```

## src/opamp.c
```c
/*
 * Copyright 2026 NXP
 * SPDX-License-Identifier: Apache-2.0
 */

/**
 * @file
 * @brief The register view of the OPAMP block, shared by every layer.
 */

#include <zephyr/sys/util.h>
#include <zephyr/tc_util.h>

#include <fsl_device_registers.h>

#include "opamp.h"

const struct device *const opamp_dev = DEVICE_DT_GET(OPAMP_NODE);

static OPAMP_Type *const base = (OPAMP_Type *)DT_REG_ADDR(OPAMP_NODE);

#if defined(CONFIG_OPAMP_MCUX_OPAMP)

#define OPAMP_GAIN_MASK (OPAMP_OPAMP_CTR_NGAIN_MASK | OPAMP_OPAMP_CTR_PGAIN_MASK)
#define OPAMP_CONFIG_MASK (~(OPAMP_OPAMP_CTR_EN_MASK | OPAMP_GAIN_MASK))

bool opamp_en(void)
{
	return (base->OPAMP_CTR & OPAMP_OPAMP_CTR_EN_MASK) != 0U;
}

uint32_t opamp_config_bits(void)
{
	return base->OPAMP_CTR & OPAMP_CONFIG_MASK;
}

uint32_t opamp_gain_fields(void)
{
	return base->OPAMP_CTR & OPAMP_GAIN_MASK;
}

void opamp_clobber(void)
{
	base->OPAMP_CTR = 0U;
}

int opamp_configure_gain(enum opamp_gain gain)
{
	return opamp_set_gain(OPAMP_DEV, gain);
}

void opamp_report_hw(const char *when)
{
	TC_PRINT("hw(%s) OPAMP_CTR=0x%08x EN=%u gain=0x%08x\n", when, base->OPAMP_CTR,
		 opamp_en() ? 1U : 0U, opamp_gain_fields());
}

#elif defined(CONFIG_OPAMP_MCUX_OPAMP_FAST)

#define OPAMP_CONFIG_MASK (~OPAMP_OPAMP_CTRL_OPA_EN_MASK)

bool opamp_en(void)
{
	return (base->OPAMP_CTRL & OPAMP_OPAMP_CTRL_OPA_EN_MASK) != 0U;
}

uint32_t opamp_config_bits(void)
{
	return base->OPAMP_CTRL & OPAMP_CONFIG_MASK;
}

void opamp_clobber(void)
{
	base->OPAMP_CTRL = 0U;
}

void opamp_report_hw(const char *when)
{
	TC_PRINT("hw(%s) OPAMP_CTRL=0x%08x EN=%u\n", when, base->OPAMP_CTRL,
		 opamp_en() ? 1U : 0U);
}

#endif
```

## src/opamp.h
```c
/*
 * Copyright 2026 NXP
 * SPDX-License-Identifier: Apache-2.0
 */

/**
 * @file
 * @brief What every layer of the OPAMP case needs from the hardware.
 *
 * The opamp API has no enable or disable call: being PM_DEVICE_STATE_ACTIVE is the
 * only thing that turns the amplifier on, so the EN bit this case reads tracks the
 * PM state 1:1, with no "configured but not driving" phase like LPDAC's DACEN. What
 * this case observes is the register block directly, not the driver's view of it,
 * the same way tests/lpcmp does: a PM state machine that has drifted away from the
 * hardware is exactly what reading the register catches.
 *
 * Two driver variants share this header. CONFIG_OPAMP_MCUX_OPAMP (register
 * OPAMP_CTR) implements set_gain() and is the only one the gain assertions run
 * against; CONFIG_OPAMP_MCUX_OPAMP_FAST (register OPAMP_CTRL) returns -ENOTSUP for
 * set_gain() unconditionally and has no gain fields to read back.
 */

#ifndef OPAMP_PM_H_
#define OPAMP_PM_H_

#include <stdbool.h>
#include <stdint.h>
#include <zephyr/device.h>
#include <zephyr/devicetree.h>
#include <zephyr/drivers/opamp.h>

#if !DT_NODE_EXISTS(DT_ALIAS(test_opamp))
#error "This board has no OPAMP wiring: add boards/<board_target>.overlay with a test-opamp alias"
#endif

#define OPAMP_NODE DT_ALIAS(test_opamp)

#if !defined(CONFIG_OPAMP_MCUX_OPAMP) && !defined(CONFIG_OPAMP_MCUX_OPAMP_FAST)
#error "Neither CONFIG_OPAMP_MCUX_OPAMP nor CONFIG_OPAMP_MCUX_OPAMP_FAST is enabled"
#endif

/** The opamp under test. */
extern const struct device *const opamp_dev;
#define OPAMP_DEV opamp_dev

/** True while the hardware EN bit says the amplifier is driving its output. */
bool opamp_en(void);

/**
 * @brief The devicetree configuration half of the register block.
 *
 * Everything PM_DEVICE_ACTION_TURN_ON rebuilds: the fixed fields set_gain() does
 * not touch and SUSPEND/RESUME do not touch either. Excludes EN, and on the
 * gain-capable variant also excludes the gain fields, which TURN_ON leaves at
 * their reset value -- RESUME is what replays them.
 */
uint32_t opamp_config_bits(void);

/**
 * @brief Clear the register block, leaving it looking the way a reset leaves it.
 *
 * What stands in for a power cycle in a layer where nothing really cut power to
 * the block, so that TURN_ON has something to restore.
 */
void opamp_clobber(void);

/**
 * @brief Print the register view.
 *
 * @param when short label for where in the sequence this is, e.g. "before".
 */
void opamp_report_hw(const char *when);

#if defined(CONFIG_OPAMP_MCUX_OPAMP)
/**
 * @brief Apply a gain through the driver's public API.
 *
 * A thin wrapper so every layer asks for gain the same way a real consumer would,
 * through opamp_set_gain(), rather than reaching into the driver.
 *
 * @return 0 on success, negative errno from opamp_set_gain() otherwise.
 */
int opamp_configure_gain(enum opamp_gain gain);

/**
 * @brief NGAIN and PGAIN together: the one pair of fields set_gain() writes and
 *        TURN_ON does not rebuild -- RESUME replays them from driver state instead.
 */
uint32_t opamp_gain_fields(void);
#endif /* CONFIG_OPAMP_MCUX_OPAMP */

#endif /* OPAMP_PM_H_ */
```

## src/test_control.c
```c
/*
 * Copyright 2026 NXP
 * SPDX-License-Identifier: Apache-2.0
 */

/**
 * @file
 * @brief The control: this case really does drive the opamp.
 *
 * Compiled into every layer. If this fails, no verdict from the layer under test
 * means anything -- which is the whole reason the baseline layer exists as a layer.
 */

#include <zephyr/pm/device_runtime.h>
#include <zephyr/ztest.h>

#include "opamp.h"

ZTEST(opamp_pm, test_control_en)
{
	bool held = false;
	bool en;
	uint32_t config;
#if defined(CONFIG_OPAMP_MCUX_OPAMP)
	int gain_rc;
#endif

	/*
	 * Where runtime PM owns the device it boots suspended, and this driver takes
	 * no reference of its own: being ACTIVE is the only thing that turns the
	 * amplifier on, so the control has to ask for the device explicitly. That an
	 * unwrapped call is refused instead of being served is test_runtime.c's claim,
	 * not a premise of the control.
	 */
	if (pm_device_runtime_is_enabled(OPAMP_DEV)) {
		zassert_ok(pm_device_runtime_get(OPAMP_DEV),
			   "could not resume the device for the control");
		held = true;
	}

#if defined(CONFIG_OPAMP_MCUX_OPAMP)
	gain_rc = opamp_configure_gain(OPAMP_GAIN_2);
#endif

	en = opamp_en();
	config = opamp_config_bits();
	opamp_report_hw("control");

	if (held) {
		/* Before the assertions below: a failure must not leak the reference. */
		(void)pm_device_runtime_put(OPAMP_DEV);
	}

	zassert_true(en, "the EN bit is clear while the opamp is ACTIVE");

	/*
	 * What the driver wrote from the devicetree. A cleared register is what a
	 * reset leaves, and every later layer tells "restored" from "came back from
	 * reset" by comparing against this, so a case in which it is empty proves
	 * nothing anywhere.
	 */
	zassert_not_equal(config, 0U, "the register carries no configuration once ACTIVE");

#if defined(CONFIG_OPAMP_MCUX_OPAMP)
	zassert_ok(gain_rc, "opamp_set_gain() failed (%d)", gain_rc);
	zassert_not_equal(opamp_gain_fields(), 0U,
			  "the gain fields are still 0 after requesting a non-default gain");
#endif
}
```

## src/test_device.c
```c
/*
 * Copyright 2026 NXP
 * SPDX-License-Identifier: Apache-2.0
 */

/**
 * @file
 * @brief The device layer: the driver's PM callbacks, driven directly.
 *
 * Two tests, and they are two because they are about two different halves of the
 * callback. The first is the SUSPEND/RESUME round trip, which owns the EN bit and,
 * on the gain-capable variant, the gain fields RESUME replays. The second is
 * TURN_OFF/TURN_ON, which owns the devicetree configuration half of the register
 * block -- and since nothing in this layer really cut power to it, the block is
 * cleared by hand so that TURN_ON has something to restore. What a real power
 * cycle does is asked in src/test_lowpower.c under the dpd layer.
 */

#include <zephyr/pm/device.h>
#include <zephyr/ztest.h>

#include <pm_test/state.h>

#include "opamp.h"

ZTEST(opamp_pm, test_device_suspend_resume)
{
	uint32_t config;

	/* No runtime PM in this layer, so pm_device_driver_init() resumed it. */
	zassert_pm_state(OPAMP_DEV, PM_DEVICE_STATE_ACTIVE);
	zassert_true(opamp_en(), "EN clear while PM reports ACTIVE");
	config = opamp_config_bits();

#if defined(CONFIG_OPAMP_MCUX_OPAMP)
	uint32_t gain;
	int set_gain_rc;

	zassert_ok(opamp_configure_gain(OPAMP_GAIN_4), "opamp_set_gain() failed before SUSPEND");
	gain = opamp_gain_fields();
#endif

	zassert_ok(pm_device_action_run(OPAMP_DEV, PM_DEVICE_ACTION_SUSPEND),
		   "SUSPEND action rejected");
	zassert_pm_state(OPAMP_DEV, PM_DEVICE_STATE_SUSPENDED);
	zassert_false(opamp_en(), "EN still set after SUSPEND");
	zassert_equal(opamp_config_bits(), config,
		      "SUSPEND changed the configuration: 0x%08x -> 0x%08x", config,
		      opamp_config_bits());

	/*
	 * The API contract while the device is not active. Returning an error is the
	 * whole point: the alternative is writing the gain fields behind PM's back,
	 * which either is overwritten the moment the amplifier is enabled again or is
	 * thrown away by the next power cycle, and the caller is told neither.
	 */
#if defined(CONFIG_OPAMP_MCUX_OPAMP)
	set_gain_rc = opamp_configure_gain(OPAMP_GAIN_8);
	zassert_equal(set_gain_rc, -EBUSY,
		      "set_gain against a SUSPENDED device returned %d, want -EBUSY",
		      set_gain_rc);
	zassert_equal(opamp_gain_fields(), gain,
		      "a refused set_gain changed the stored gain fields");
#endif
	zassert_false(opamp_en(), "a refused call re-enabled the amplifier");

	zassert_ok(pm_device_action_run(OPAMP_DEV, PM_DEVICE_ACTION_RESUME),
		   "RESUME action rejected");
	zassert_pm_state(OPAMP_DEV, PM_DEVICE_STATE_ACTIVE);
	opamp_report_hw("after-resume");

	/* The configuration comes back without the consumer doing anything, and so
	 * does the gain the consumer last asked for -- this is the fix under test.
	 */
	zassert_true(opamp_en(), "RESUME did not re-enable the amplifier");
	zassert_equal(opamp_config_bits(), config,
		      "RESUME left a different configuration: 0x%08x, want 0x%08x",
		      opamp_config_bits(), config);
#if defined(CONFIG_OPAMP_MCUX_OPAMP)
	zassert_equal(opamp_gain_fields(), gain,
		      "RESUME left gain fields 0x%08x, want the last requested gain 0x%08x",
		      opamp_gain_fields(), gain);
#endif

	/* A redundant action must be refused, not obeyed and not fatal. */
	int err = pm_device_action_run(OPAMP_DEV, PM_DEVICE_ACTION_RESUME);

	zassert_equal(err, -EALREADY, "second RESUME returned %d, want -EALREADY", err);
}

ZTEST(opamp_pm, test_device_turn_on_rebuilds_the_register_block)
{
	uint32_t config;
	uint32_t config_clobbered;
	uint32_t config_after_turn_on;
	bool en_after_turn_on;
	bool en_after_resume;
	int suspend_rc;
	int turn_off_rc;
	int turn_on_rc;
	int resume_rc;

	zassert_pm_state(OPAMP_DEV, PM_DEVICE_STATE_ACTIVE);
	config = opamp_config_bits();

#if defined(CONFIG_OPAMP_MCUX_OPAMP)
	uint32_t gain;
	uint32_t gain_after_turn_on;
	uint32_t gain_after_resume;

	zassert_ok(opamp_configure_gain(OPAMP_GAIN_16), "opamp_set_gain() failed");
	gain = opamp_gain_fields();
#endif

	/* Collected in one go and asserted afterwards, so that a failure cannot hand
	 * the next test a device the core still records as OFF.
	 */
	suspend_rc = pm_device_action_run(OPAMP_DEV, PM_DEVICE_ACTION_SUSPEND);
	opamp_clobber();
	config_clobbered = opamp_config_bits();

	turn_off_rc = pm_device_action_run(OPAMP_DEV, PM_DEVICE_ACTION_TURN_OFF);

	turn_on_rc = pm_device_action_run(OPAMP_DEV, PM_DEVICE_ACTION_TURN_ON);
	config_after_turn_on = opamp_config_bits();
	en_after_turn_on = opamp_en();
#if defined(CONFIG_OPAMP_MCUX_OPAMP)
	gain_after_turn_on = opamp_gain_fields();
#endif
	opamp_report_hw("after-turn-on");

	resume_rc = pm_device_action_run(OPAMP_DEV, PM_DEVICE_ACTION_RESUME);
	en_after_resume = opamp_en();
#if defined(CONFIG_OPAMP_MCUX_OPAMP)
	gain_after_resume = opamp_gain_fields();
#endif
	opamp_report_hw("after-resume");

	zassert_ok(suspend_rc, "SUSPEND rejected (%d)", suspend_rc);
	zassert_ok(turn_off_rc, "TURN_OFF rejected (%d)", turn_off_rc);
	zassert_ok(turn_on_rc, "TURN_ON rejected (%d)", turn_on_rc);
	zassert_ok(resume_rc, "RESUME rejected (%d)", resume_rc);
	zassert_pm_state(OPAMP_DEV, PM_DEVICE_STATE_ACTIVE);

	/* Before anything else: a clobber that did not take would make the restore
	 * assertions below pass without the driver having rebuilt a thing.
	 */
	zassert_not_equal(config_clobbered, config,
			  "the clobber did not take, so this test proves nothing");

	zassert_equal(config_after_turn_on, config,
		      "TURN_ON left 0x%08x, want the devicetree configuration 0x%08x",
		      config_after_turn_on, config);

	/*
	 * And it has to stop there. TURN_ON returns with the core about to record the
	 * device as suspended, so a block left enabled would be driving an output
	 * that PM believes is quiet; enabling it is RESUME's job.
	 */
	zassert_false(en_after_turn_on, "TURN_ON left the amplifier enabled");
	zassert_true(en_after_resume, "RESUME did not enable the amplifier");

#if defined(CONFIG_OPAMP_MCUX_OPAMP)
	/*
	 * The gain fields are runtime state, not devicetree configuration -- TURN_ON
	 * does not own them, and after a clobber they read back as 0 until something
	 * replays the last gain this driver applied.
	 */
	zassert_equal(gain_after_turn_on, 0U,
		      "TURN_ON restored gain fields 0x%08x; it owns devicetree "
		      "configuration, not driver state", gain_after_turn_on);
	zassert_equal(gain_after_resume, gain,
		      "RESUME left gain fields 0x%08x, want the last requested gain 0x%08x",
		      gain_after_resume, gain);
#endif
}
```

## src/test_lowpower.c
```c
/*
 * Copyright 2026 NXP
 * SPDX-License-Identifier: Apache-2.0
 */

/**
 * @file
 * @brief The sysmanaged and dpd layers: the device sweep across one transition.
 *
 * One file for two layers, because the sequence is identical and only the state
 * being entered differs -- and that difference is what separates the two claims.
 * In sysmanaged the sweep's SUSPEND and RESUME are all that happen, so re-enabling
 * the amplifier and replaying its gain is enough. In dpd the CORE domain is power
 * gated: the register block comes back at its reset value and nothing re-runs
 * driver init, so the domain's TURN_ON has to rebuild the devicetree configuration
 * before RESUME can put EN and the gain back on top of it. dpd is the only layer
 * that can catch a driver with no restore path for either half -- it is what the
 * RESUME gain-replay fix this case exists for is actually proving.
 *
 * The application's part is holding the amplifier on across the transition, which
 * is why the sequence below asks for it directly rather than through a reference:
 * this driver never resumes itself, and these layers run with no runtime PM, so an
 * output that was never turned on is not one the sweep owes anything to.
 */

#include <zephyr/pm/device.h>
#include <zephyr/ztest.h>

#include <pm_test/lowpower.h>
#include <pm_test/state.h>

#include "opamp.h"

ZTEST(opamp_pm, test_sweep_across_transition)
{
	uint32_t config;
	uint32_t config_after;
	bool en_after;

	/* No runtime PM in these layers, so the sweep is the only thing that will
	 * suspend the device.
	 */
	zassert_pm_state(OPAMP_DEV, PM_DEVICE_STATE_ACTIVE);
	zassert_true(opamp_en(), "EN clear before the transition");
	config = opamp_config_bits();

#if defined(CONFIG_OPAMP_MCUX_OPAMP)
	uint32_t gain;
	uint32_t gain_after;

	zassert_ok(opamp_configure_gain(OPAMP_GAIN_8), "opamp_set_gain() failed before the "
							"transition");
	gain = opamp_gain_fields();
#endif
	opamp_report_hw("before");

	pm_test_enter_transition();

	/* Sampled before the console is revived: reviving it takes time, and the
	 * question is what the block looked like the moment the sweep handed it back.
	 */
	config_after = opamp_config_bits();
	en_after = opamp_en();
#if defined(CONFIG_OPAMP_MCUX_OPAMP)
	gain_after = opamp_gain_fields();
#endif

	pm_test_console_resume(PM_TEST_CONSOLE_REINIT_PINMUX);
	TC_PRINT("resumed from %s\n", PM_TEST_TRANSITION_NAME);
	opamp_report_hw("after-resume");

	/*
	 * pm_resume_devices() walks the devices it suspended in init order, so the
	 * core domain's TURN_ON has already run by the time the opamp's own RESUME
	 * does. The two together have to leave both EN and the gain the consumer last
	 * asked for.
	 */
	zassert_pm_state(OPAMP_DEV, PM_DEVICE_STATE_ACTIVE);
	zassert_equal(config_after, config,
		      "the configuration did not survive the transition: 0x%08x, want 0x%08x",
		      config_after, config);
	zassert_true(en_after, "EN was not put back for an amplifier that never let go");
#if defined(CONFIG_OPAMP_MCUX_OPAMP)
	zassert_equal(gain_after, gain,
		      "the gain did not survive the transition: 0x%08x, want 0x%08x",
		      gain_after, gain);
#endif
}
```

## src/test_runtime.c
```c
/*
 * Copyright 2026 NXP
 * SPDX-License-Identifier: Apache-2.0
 */

/**
 * @file
 * @brief The runtime layer: the consumer owns the amplifier, and says so with a
 *        reference.
 *
 * This driver takes no runtime PM reference of its own: being ACTIVE is the only
 * thing that turns the amplifier on, and there is no completion event a put()
 * could hang on. The reference is the consumer's, and a call that arrives without
 * one is refused.
 *
 * Two tests. The first has to run first: it reads the state the device booted in,
 * and the second leaves it suspended.
 */

#include <zephyr/pm/device.h>
#include <zephyr/pm/device_runtime.h>
#include <zephyr/ztest.h>

#include <pm_test/state.h>

#include "opamp.h"

ZTEST(opamp_pm, test_runtime_boots_without_a_consumer)
{
	enum pm_device_state state;

	zassert_true(pm_device_runtime_is_enabled(OPAMP_DEV),
		     "runtime PM is not enabled on %s, so this layer tests nothing",
		     OPAMP_DEV->name);

	/*
	 * Two boot states are legal. Without a power domain the device lands in
	 * SUSPENDED: pm_device_driver_init() ran TURN_ON and stopped short of RESUME
	 * because runtime PM is about to take over. With a domain it lands in OFF,
	 * because the domain is runtime-suspended before the opamp initialises and
	 * TURN_ON was skipped -- pd-soc-state-change-no-turn-on-under-runtime-pm in
	 * docs/findings.md.
	 */
	zassert_ok(pm_device_state_get(OPAMP_DEV, &state), "pm_device_state_get() failed");
	zassert_true((state == PM_DEVICE_STATE_SUSPENDED) || (state == PM_DEVICE_STATE_OFF),
		     "%s booted %s, want SUSPENDED or OFF under runtime PM", OPAMP_DEV->name,
		     pm_device_state_str(state));

	/* Nothing may be driving an output before a consumer has asked for one. */
	zassert_false(opamp_en(), "EN set before any consumer took a reference");

#if defined(CONFIG_OPAMP_MCUX_OPAMP)
	int rc = opamp_configure_gain(OPAMP_GAIN_2);

	zassert_equal(rc, -EBUSY, "set_gain without a reference returned %d, want -EBUSY", rc);
#endif
	zassert_false(opamp_en(), "a refused call enabled the amplifier");
}

ZTEST(opamp_pm, test_runtime_reference_counting)
{
#if defined(CONFIG_OPAMP_MCUX_OPAMP)
	uint32_t gain;
#endif

	zassert_ok(pm_device_runtime_get(OPAMP_DEV), "runtime_get rejected");
	zassert_pm_state(OPAMP_DEV, PM_DEVICE_STATE_ACTIVE);
	zassert_true(opamp_en(), "EN clear while PM reports ACTIVE");

#if defined(CONFIG_OPAMP_MCUX_OPAMP)
	zassert_ok(opamp_configure_gain(OPAMP_GAIN_2), "set_gain under a held reference failed");
	gain = opamp_gain_fields();
#endif

	/* A second reference must not be a second resume, and releasing it must not
	 * disable an amplifier somebody else is still holding.
	 */
	zassert_ok(pm_device_runtime_get(OPAMP_DEV), "nested runtime_get rejected");
	zassert_ok(pm_device_runtime_put(OPAMP_DEV), "first runtime_put rejected");
	zassert_pm_state(OPAMP_DEV, PM_DEVICE_STATE_ACTIVE);
	zassert_true(opamp_en(), "the amplifier was disabled while a reference was held");

	zassert_ok(pm_device_runtime_put(OPAMP_DEV), "last runtime_put rejected");
	zassert_pm_state(OPAMP_DEV, PM_DEVICE_STATE_SUSPENDED);
	opamp_report_hw("after-put");
	zassert_false(opamp_en(), "EN still set after the last runtime_put");

	/*
	 * And the consumer gets its gain back by taking the reference again, without
	 * calling set_gain() a second time: what it asked for is the driver's to
	 * remember across a suspend it did not ask for.
	 */
	zassert_ok(pm_device_runtime_get(OPAMP_DEV), "runtime_get after the put rejected");
	opamp_report_hw("after-reget");
	zassert_true(opamp_en(), "the amplifier did not come back with the reference");
#if defined(CONFIG_OPAMP_MCUX_OPAMP)
	zassert_equal(opamp_gain_fields(), gain,
		      "gain changed across the suspend: 0x%08x, want 0x%08x",
		      opamp_gain_fields(), gain);
#endif

	/* Left as it was found, so this test's output does not outlive it. */
	zassert_ok(pm_device_runtime_put(OPAMP_DEV), "final runtime_put rejected");
}
```

## src/test_system.c
```c
/*
 * Copyright 2026 NXP
 * SPDX-License-Identifier: Apache-2.0
 */

/**
 * @file
 * @brief The system layer: the per-device power state constraint.
 *
 * &opamp0 lists the states that cut the amplifier's bias in
 * zephyr,disabling-power-states (see constraints.overlay). Like the LPCMP driver
 * and unlike LPDAC's, this driver takes no policy lock of its own -- an opamp is
 * useful for as long as the application wants its output, not for the length of
 * one call -- so holding the constraint is the application's job, and both tests
 * here are written the way an application has to write it.
 */

#include <zephyr/pm/device_runtime.h>
#include <zephyr/pm/policy.h>
#include <zephyr/pm/state.h>
#include <zephyr/ztest.h>

#include <pm_test/lowpower.h>

#include "opamp.h"

ZTEST(opamp_pm, test_system_constraint_covers_the_declared_states)
{
	unsigned int declared = 0;

	pm_test_console_quiesce();

	for (enum pm_state state = PM_STATE_ACTIVE; state < PM_STATE_COUNT; state++) {
		zassert_false(pm_policy_state_lock_is_active(state, 0),
			      "power state %d was already locked before the test", state);
	}

	pm_policy_device_power_lock_get(OPAMP_DEV);

	for (enum pm_state state = PM_STATE_ACTIVE; state < PM_STATE_COUNT; state++) {
		bool disabling = pm_policy_device_is_disabling_state(OPAMP_DEV, state, 0);

		declared += disabling ? 1U : 0U;
		zassert_equal(pm_policy_state_lock_is_active(state, 0), disabling,
			      "power state %d: locked=%d but declared disabling=%d", state,
			      (int)pm_policy_state_lock_is_active(state, 0), (int)disabling);
	}

	/*
	 * Without this the loop above would compare "nothing locked" against "nothing
	 * declared" and pass while proving nothing -- which is exactly what a
	 * constraints.overlay that failed to reach &opamp0 looks like. States that are
	 * listed but disabled in the devicetree are dropped from the generated table,
	 * so on a board where all of them are disabled this is the check that fires.
	 */
	zassert_true(declared > 0,
		     "no disabling power state reached the constraint table; is "
		     "constraints.overlay applied to this board's opamp node?");

	pm_policy_device_power_lock_put(OPAMP_DEV);

	pm_test_console_quiesce();
	for (enum pm_state state = PM_STATE_ACTIVE; state < PM_STATE_COUNT; state++) {
		zassert_false(pm_policy_state_lock_is_active(state, 0),
			      "power state %d is still locked after the constraint was "
			      "released", state);
	}
}

ZTEST(opamp_pm, test_system_opamp_usable_under_the_constraint)
{
	bool en;
	uint32_t config;
#if defined(CONFIG_OPAMP_MCUX_OPAMP)
	int gain_rc;
	uint32_t gain;
#endif

	/* The pair an application needs: the reference keeps the block powered, the
	 * constraint keeps the policy from picking a state that would unpower it.
	 */
	pm_policy_device_power_lock_get(OPAMP_DEV);
	zassert_ok(pm_device_runtime_get(OPAMP_DEV), "runtime_get rejected");

#if defined(CONFIG_OPAMP_MCUX_OPAMP)
	gain_rc = opamp_configure_gain(OPAMP_GAIN_2);
	gain = opamp_gain_fields();
#endif
	en = opamp_en();
	config = opamp_config_bits();

	/* Released before anything is asserted: a failure must not leave a lock or a
	 * reference behind, either of which would silently distort the rest of the run.
	 */
	(void)pm_device_runtime_put(OPAMP_DEV);
	pm_policy_device_power_lock_put(OPAMP_DEV);

	zassert_true(en, "EN clear while a runtime reference was held");
	zassert_not_equal(config, 0U, "the register carries no configuration while ACTIVE");
#if defined(CONFIG_OPAMP_MCUX_OPAMP)
	zassert_ok(gain_rc, "opamp_set_gain() failed (%d)", gain_rc);
	zassert_not_equal(gain, 0U,
			  "the gain fields are still 0 after requesting a non-default gain");
#endif
}
```
