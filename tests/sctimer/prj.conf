## CMakeLists.txt
```
# Copyright 2026 NXP
# SPDX-License-Identifier: Apache-2.0

cmake_minimum_required(VERSION 3.20.0)

# Pulls in this repository as a Zephyr module, which is what makes lib/pm_test,
# include/pm_test and the snippets/pm-* snippets available. Nothing has to be
# passed on the command line: `-S pm-<layer>` is the whole interface.
list(APPEND EXTRA_ZEPHYR_MODULES ${CMAKE_CURRENT_LIST_DIR}/../..)

find_package(Zephyr REQUIRED HINTS $ENV{ZEPHYR_BASE})
project(sctimer_device_pm)

# The suite, the register view, and the control test that every layer runs.
target_sources(app PRIVATE src/main.c src/sctimer.c src/test_control.c)

# One file per layer. A layer's file is the only place that layer's claims live,
# so a build for a layer contains no code belonging to any other.
target_sources_ifdef(CONFIG_PM_TEST_LAYER_DEVICE     app PRIVATE src/test_device.c)
target_sources_ifdef(CONFIG_PM_TEST_LAYER_RUNTIME    app PRIVATE src/test_runtime.c)
target_sources_ifdef(CONFIG_PM_TEST_LAYER_SYSTEM     app PRIVATE src/test_system.c)
target_sources_ifdef(CONFIG_PM_TEST_LAYER_SYSMANAGED app PRIVATE src/test_lowpower.c)
target_sources_ifdef(CONFIG_PM_TEST_LAYER_DPD        app PRIVATE src/test_lowpower.c)
```

## prj.conf
```kconfig
# Copyright 2026 NXP
# SPDX-License-Identifier: Apache-2.0
#
# Layer-independent configuration only. The PM symbols come from the layer, which
# comes from the pm-* snippet; see lib/pm_test/Kconfig and docs/pm-layers.md.

CONFIG_ZTEST=y
CONFIG_PM_TEST=y

CONFIG_PWM=y

# Driver logging at info level, immediate: the run ends with interrupts locked so
# that the core cannot park in WFI, and a deferred log would never be flushed.
# include/pm_test/layer.h asserts this pairing.
CONFIG_LOG=y
CONFIG_LOG_MODE_IMMEDIATE=y
CONFIG_PWM_LOG_LEVEL_INF=y
```

## constraints.overlay
```dts
/*
 * Copyright 2026 NXP
 * SPDX-License-Identifier: Apache-2.0
 *
 * System-PM constraint layer: mark which SoC power states stop this SCTimer
 * counting. Stacked on top of whatever the board target already applies, for the
 * system layer only (via EXTRA_DTC_OVERLAY_FILE).
 *
 * The board target in platform_allow gets this list from nxp_mcxnx4x_common.dtsi, so
 * this restates what is already there. It is kept so the system layer does not depend
 * on that dtsi commit being in the tree: on a checkout without it, this is what
 * supplies the list.
 *
 * All three states are listed, and for the SCTimer the reason is the block and not
 * only the clock. Per MCX Nx4x RM Rev. 6_RC2 section 35.4 Table 336 the SCT is
 * "Static" in Deep Sleep and Power Down -- it has no asynchronous functional clock to
 * keep it counting there, so no board can wire around it -- and "Off" in Deep Power
 * Down, where the CORE domain is gated and the registers are reset.
 */

&sc_timer {
	zephyr,disabling-power-states = <&deepsleep &powerdown &deeppowerdown>;
};
```

## src/main.c
```c
/*
 * Copyright 2026 NXP
 * SPDX-License-Identifier: Apache-2.0
 */

/**
 * @file
 * @brief SCTimer device-PM suite: the suite hooks, and nothing else.
 *
 * Which layer this build tests, and therefore which src/test_*.c is compiled in,
 * is decided by the pm-* snippet on the command line. See docs/pm-layers.md.
 */

#include <zephyr/ztest.h>

#include <pm_test/layer.h>
#include <pm_test/state.h>

#include "sctimer.h"

static void *sctimer_pm_setup(void)
{
	(void)pm_test_setup();
	sctimer_report_configuration();

	SCTIMER_FOREACH_CASE(c) {
		pm_test_note_state(c->dev, "at boot");
		sctimer_report_hw(c, "at boot");
	}

	return NULL;
}

static void sctimer_pm_before(void *fixture)
{
	ARG_UNUSED(fixture);

	SCTIMER_FOREACH_CASE(c) {
		zassert_true(device_is_ready(c->dev), "%s is not ready", c->dev->name);
	}
}

ZTEST_SUITE(sctimer_pm, NULL, sctimer_pm_setup, sctimer_pm_before, NULL, NULL);
```

## src/sctimer.c
```c
/*
 * Copyright 2026 NXP
 * SPDX-License-Identifier: Apache-2.0
 */

/**
 * @file
 * @brief The SCTimer wiring, and the hardware truths this case asserts on.
 */

#include <zephyr/devicetree.h>
#include <zephyr/kernel.h>
#include <zephyr/sys/util.h>
#include <zephyr/tc_util.h>

#include <zephyr/dt-bindings/clock/mcux_lpc_syscon_clock.h>
#include <fsl_clock.h>
#include <soc.h>

#include "sctimer.h"

/*
 * The clock gate is read out of the MCX clock controller's own register, so a part
 * wiring this driver to some other clock controller would need a different mapping
 * and is refused here rather than read out of the wrong register.
 */
#define SCTIMER_ASSERT_SYSCON_CLOCK(node_id)                                                       \
	BUILD_ASSERT(DT_NODE_HAS_COMPAT(DT_CLOCKS_CTLR(node_id), nxp_lpc_syscon),                  \
		     "this case reads the SCTimer clock gate out of the MCX clock controller "      \
		     "and only fits SoCs whose SCTimer clock comes from nxp,lpc-syscon");

DT_FOREACH_STATUS_OKAY(nxp_sctimer_pwm, SCTIMER_ASSERT_SYSCON_CLOCK)

#define SCTIMER_ENTRY(node_id)                                                                     \
	{                                                                                          \
		.dev = DEVICE_DT_GET(node_id),                                                     \
		.base = (uintptr_t)DT_REG_ADDR(node_id),                                           \
	},

const struct sctimer_case sctimer_cases[SCTIMER_CASE_COUNT] = {
	DT_FOREACH_STATUS_OKAY(nxp_sctimer_pwm, SCTIMER_ENTRY)
};

/*
 * SCT_CLOCKS carries the gate constant for whichever SoC is being built -- the enum
 * is named kCLOCK_Sct on some parts and kCLOCK_Sct0 on others -- and is absent on
 * parts with no SCTimer. Same table the syscon clock driver's own SCTimer cases use.
 */
#if defined(SCT_CLOCKS)
static const clock_ip_name_t sct_clocks[] = SCT_CLOCKS;
#endif

/* The match register pair the SDK allocates for the first channel it sets up. */
#define SCTIMER_MATCH_PERIOD 0U
#define SCTIMER_MATCH_PULSE  1U

/*
 * The last match reload register, and a value that cannot be mistaken for a reset.
 * The SDK hands out match registers from 0 upwards, one pair per channel, and this
 * board target routes one output, so the top of the array is never written by the
 * driver. 24 bits, because the register is 16-bit wide when the counter is split in
 * two and this must read back unchanged in either configuration.
 */
#define SCTIMER_MATCH_WITNESS (FSL_FEATURE_SCT_NUMBER_OF_MATCH_CAPTURE - 1U)
#define SCTIMER_WITNESS_VALUE 0x00A5A5U

static SCT_Type *sctimer_base(const struct sctimer_case *c)
{
	return (SCT_Type *)c->base;
}

bool sctimer_gate_observable(const struct sctimer_case *c)
{
	ARG_UNUSED(c);

#if defined(SCT_CLOCKS)
	return true;
#else
	return false;
#endif
}

/*
 * CLOCK_EnableClock()/CLOCK_DisableClock() write through the write-only SET/CLR
 * aliases, so the readable register is the one at the head of the group:
 * SYSCON->AHBCLKCTRL0..3, contiguous from 0x200.
 */
bool sctimer_gate_is_open(const struct sctimer_case *c)
{
	ARG_UNUSED(c);

#if defined(SCT_CLOCKS)
	const volatile uint32_t *reg =
		&(&SYSCON->AHBCLKCTRL0)[CLK_GATE_ABSTRACT_REG_OFFSET(sct_clocks[0])];

	return (*reg & BIT(CLK_GATE_ABSTRACT_BITS_SHIFT(sct_clocks[0]))) != 0U;
#else
	return false;
#endif
}

void sctimer_gate_open(const struct sctimer_case *c)
{
	ARG_UNUSED(c);

#if defined(SCT_CLOCKS)
	CLOCK_EnableClock(sct_clocks[0]);
#endif
}

void sctimer_gate_close(const struct sctimer_case *c)
{
	ARG_UNUSED(c);

#if defined(SCT_CLOCKS)
	CLOCK_DisableClock(sct_clocks[0]);
#endif
}

void sctimer_image_read(const struct sctimer_case *c, struct sctimer_image *img)
{
	SCT_Type *base = sctimer_base(c);

	img->matchrel_period = base->MATCHREL[SCTIMER_MATCH_PERIOD];
	img->matchrel_pulse = base->MATCHREL[SCTIMER_MATCH_PULSE];
	img->out_set = base->OUT[SCTIMER_PWM_CHANNEL].SET;
	img->out_clr = base->OUT[SCTIMER_PWM_CHANNEL].CLR;
}

bool sctimer_image_equal(const struct sctimer_image *a, const struct sctimer_image *b)
{
	return (a->matchrel_period == b->matchrel_period) &&
	       (a->matchrel_pulse == b->matchrel_pulse) && (a->out_set == b->out_set) &&
	       (a->out_clr == b->out_clr);
}

bool sctimer_image_is_clear(const struct sctimer_image *img)
{
	return (img->matchrel_period == 0U) && (img->matchrel_pulse == 0U) &&
	       (img->out_set == 0U) && (img->out_clr == 0U);
}

void sctimer_clobber(const struct sctimer_case *c, struct sctimer_image *clobbered)
{
	SCT_Type *base = sctimer_base(c);
	bool was_open = sctimer_gate_is_open(c);

	/* The registers cannot be written while the block is unclocked, and this is
	 * called from a layer where the driver has already gated it.
	 */
	sctimer_gate_open(c);

	base->MATCHREL[SCTIMER_MATCH_PERIOD] = 0U;
	base->MATCHREL[SCTIMER_MATCH_PULSE] = 0U;
	base->OUT[SCTIMER_PWM_CHANNEL].SET = 0U;
	base->OUT[SCTIMER_PWM_CHANNEL].CLR = 0U;

	sctimer_image_read(c, clobbered);

	if (!was_open) {
		sctimer_gate_close(c);
	}
}

void sctimer_peek_gated(const struct sctimer_case *c, struct sctimer_peek *p)
{
	bool was_open = sctimer_gate_is_open(c);

	sctimer_gate_open(c);

	sctimer_image_read(c, &p->image);
	p->running = sctimer_running(c);
	p->output_high = sctimer_output_is_high(c);

	if (!was_open) {
		sctimer_gate_close(c);
	}
}

void sctimer_witness_write(const struct sctimer_case *c)
{
	sctimer_base(c)->MATCHREL[SCTIMER_MATCH_WITNESS] = SCTIMER_WITNESS_VALUE;
}

bool sctimer_witness_survives(const struct sctimer_case *c)
{
	return sctimer_base(c)->MATCHREL[SCTIMER_MATCH_WITNESS] == SCTIMER_WITNESS_VALUE;
}

bool sctimer_running(const struct sctimer_case *c)
{
	return (sctimer_base(c)->CTRL & SCT_CTRL_HALT_L_MASK) == 0U;
}


bool sctimer_output_is_high(const struct sctimer_case *c)
{
	return (sctimer_base(c)->OUTPUT & BIT(SCTIMER_PWM_CHANNEL)) != 0U;
}

bool sctimer_advances(const struct sctimer_case *c)
{
	SCT_Type *base = sctimer_base(c);
	uint32_t first = base->COUNT;

	/*
	 * Busy-waited rather than slept: the counter is clocked from the bus clock,
	 * so this is thousands of ticks even at the slowest bus frequency any board
	 * here runs, and a sleep would let the idle thread enter a power state in the
	 * layers that have one.
	 */
	k_busy_wait(200);

	return base->COUNT != first;
}

/*
 * A level read once says nothing -- a stopped output sits at some level too. This
 * samples until it has seen the output both high and low, which only a running PWM
 * produces. Bounded by a cycle count rather than by time, so it fails rather than
 * hangs if the output is parked.
 */
bool sctimer_output_toggles(const struct sctimer_case *c)
{
	bool seen_high = false;
	bool seen_low = false;

	for (unsigned int i = 0; i < 4U * SCTIMER_PWM_PERIOD; i++) {
		if (sctimer_output_is_high(c)) {
			seen_high = true;
		} else {
			seen_low = true;
		}

		if (seen_high && seen_low) {
			return true;
		}
	}

	return false;
}

int sctimer_configure(const struct sctimer_case *c)
{
	return pwm_set_cycles(c->dev, SCTIMER_PWM_CHANNEL, SCTIMER_PWM_PERIOD,
			      SCTIMER_PWM_PULSE, 0);
}

int sctimer_configure_and_verify(const struct sctimer_case *c)
{
	int err = sctimer_configure(c);

	if (err != 0) {
		return err;
	}

	return sctimer_advances(c) ? 0 : -ESTALE;
}

void sctimer_report_configuration(void)
{
	TC_PRINT("%u SCTimer instance(s) under test\n", (unsigned int)SCTIMER_CASE_COUNT);

	SCTIMER_FOREACH_CASE(c) {
		uint64_t cycles = 0;

		(void)pwm_get_cycles_per_sec(c->dev, SCTIMER_PWM_CHANNEL, &cycles);
		TC_PRINT("  %s: @ %p, %llu Hz, channel %u, gate %s\n", c->dev->name,
			 (void *)c->base, cycles, (unsigned int)SCTIMER_PWM_CHANNEL,
			 sctimer_gate_observable(c) ? "observable"
						    : "NOT observable on this SoC");
	}
}

void sctimer_report_hw(const struct sctimer_case *c, const char *when)
{
	if (!sctimer_gate_observable(c)) {
		TC_PRINT("hw(%s, %s) gate not observable on this SoC\n", when, c->dev->name);
		return;
	}

	if (!sctimer_gate_is_open(c)) {
		/* No register read: an unclocked block does not answer. */
		TC_PRINT("hw(%s, %s) gate=0, registers not read\n", when, c->dev->name);
		return;
	}

	struct sctimer_image img;

	sctimer_image_read(c, &img);
	TC_PRINT("hw(%s, %s) gate=1 halted=%u out=%u MATCHREL0=0x%08x MATCHREL1=0x%08x "
		 "SET=0x%08x CLR=0x%08x\n", when, c->dev->name, sctimer_running(c) ? 0U : 1U,
		 sctimer_output_is_high(c) ? 1U : 0U, img.matchrel_period, img.matchrel_pulse,
		 img.out_set, img.out_clr);
}
```

## src/sctimer.h
```c
/*
 * Copyright 2026 NXP
 * SPDX-License-Identifier: Apache-2.0
 */

/**
 * @file
 * @brief What the SCTimer layers share: the instance table and the register view.
 *
 * The contract this case holds the driver to, for a block that *holds* its output:
 *
 * - The consumer owns the power management reference. A PWM output drives until the
 *   consumer changes it, and there is no completion event a put() could hang on, so
 *   the driver takes no reference of its own and an API call that arrives while the
 *   device is not active is refused rather than silently dropped on the floor.
 * - A suspend halts the counter, parks every configured output at its inactive level
 *   and gates the clock, but leaves the channel programming in the registers.
 * - A resume re-opens the gate and restarts the counter for a channel the consumer
 *   had configured, without the consumer asking again.
 * - A turn-on rebuilds the block from scratch and replays the channel the consumer
 *   had configured, so a power cycle is invisible to it.
 *
 * This case makes no claim about the pad itself. Whether the pin is still driving
 * the level the SCTimer holds depends on the board's pinctrl sleep state and on what
 * the SoC does to the mux across a transition, neither of which is readable from
 * here. Everything below is read out of the SCT register block and the clock gate.
 */

#ifndef ZEPHYR_TESTS_SCTIMER_SCTIMER_H_
#define ZEPHYR_TESTS_SCTIMER_SCTIMER_H_

#include <stdbool.h>
#include <stdint.h>

#include <zephyr/device.h>
#include <zephyr/devicetree.h>
#include <zephyr/drivers/pwm.h>
#include <zephyr/sys/util.h>

#if !DT_HAS_COMPAT_STATUS_OKAY(nxp_sctimer_pwm)
#error "no enabled nxp,sctimer-pwm node: this board target cannot run this case"
#endif

#if !defined(CONFIG_PWM_MCUX_SCTIMER)
#error "CONFIG_PWM_MCUX_SCTIMER is not enabled: this case tests that driver"
#endif

/*
 * Channel 0, because frdm_mcxn947 is the only board target that routes an SCTimer
 * output and routes exactly one: SCT0_OUT0. A period in bus-clock cycles rather
 * than nanoseconds, so nothing here depends on the clock the board attached.
 */
#define SCTIMER_PWM_CHANNEL 0U
#define SCTIMER_PWM_PERIOD  1500U
#define SCTIMER_PWM_PULSE   750U

#define SCTIMER_PM_COUNT_ONE(node_id) 1 +

/** Number of enabled nxp,sctimer-pwm instances this build covers. */
#define SCTIMER_CASE_COUNT (DT_FOREACH_STATUS_OKAY(nxp_sctimer_pwm, SCTIMER_PM_COUNT_ONE) 0)

/** One SCTimer instance under test. */
struct sctimer_case {
	const struct device *dev;
	uintptr_t base;
};

extern const struct sctimer_case sctimer_cases[SCTIMER_CASE_COUNT];

/** Iterate over every instance this build covers. */
#define SCTIMER_FOREACH_CASE(c)                                                                    \
	for (const struct sctimer_case *c = &sctimer_cases[0];                                     \
	     c < &sctimer_cases[SCTIMER_CASE_COUNT]; c++)

/**
 * @brief The register state a configured channel leaves behind.
 *
 * The period and pulse reload values and the output set/clear events: between them,
 * everything the driver writes for one channel, and all of it 0 after a reset.
 */
struct sctimer_image {
	uint32_t matchrel_period;
	uint32_t matchrel_pulse;
	uint32_t out_set;
	uint32_t out_clr;
};

/** Whether the clock gate can be read on the SoC being built. */
bool sctimer_gate_observable(const struct sctimer_case *c);

/** Whether the SCTimer clock gate is open, read out of the clock controller. */
bool sctimer_gate_is_open(const struct sctimer_case *c);

/** Open the clock gate behind the driver's back, so a register can be reached. */
void sctimer_gate_open(const struct sctimer_case *c);

/** Close the clock gate behind the driver's back. */
void sctimer_gate_close(const struct sctimer_case *c);

/** Read the register image of the channel under test. */
void sctimer_image_read(const struct sctimer_case *c, struct sctimer_image *img);

/** Whether two images are the same. */
bool sctimer_image_equal(const struct sctimer_image *a, const struct sctimer_image *b);

/** Whether an image is all zeroes, which is what a reset leaves. */
bool sctimer_image_is_clear(const struct sctimer_image *img);

/** Zero the channel's registers by hand, and report what that left. */
void sctimer_clobber(const struct sctimer_case *c, struct sctimer_image *clobbered);

/** What the block looks like while it is gated, read by borrowing the clock. */
struct sctimer_peek {
	struct sctimer_image image;
	bool running;
	bool output_high;
};

/**
 * @brief Read a gated block by borrowing its clock, then hand the clock back.
 *
 * An SCT register only answers while the block is clocked, so what a suspend left in
 * there cannot be read without re-opening the gate. This opens it, reads, and closes
 * it again, leaving the hardware as it was found. The gate itself must be sampled
 * with sctimer_gate_is_open() before this is called -- afterwards it says nothing.
 */
void sctimer_peek_gated(const struct sctimer_case *c, struct sctimer_peek *p);


/**
 * @brief Write a value no driver action rewrites, as a witness for lost power.
 *
 * The driver replays the channel the consumer configured, so a restored image looks
 * the same whether the block kept its power or was rebuilt from the devicetree. This
 * writes the last match reload register, which the driver never touches: it survives
 * a suspend and comes back at its reset value from a power cycle.
 */
void sctimer_witness_write(const struct sctimer_case *c);

/** Whether the witness value is still in the register. */
bool sctimer_witness_survives(const struct sctimer_case *c);

/** Whether the counter is running, read out of CTRL. */
bool sctimer_running(const struct sctimer_case *c);

/** Whether the output under test is currently high, read out of OUTPUT. */
bool sctimer_output_is_high(const struct sctimer_case *c);

/** Whether the counter is advancing, from two reads of COUNT. */
bool sctimer_advances(const struct sctimer_case *c);

/** Whether the output is actually toggling, from repeated reads of OUTPUT. */
bool sctimer_output_toggles(const struct sctimer_case *c);

/** Configure the channel under test. Returns what pwm_set_cycles() returned. */
int sctimer_configure(const struct sctimer_case *c);

/** Configure the channel and check the counter really started. */
int sctimer_configure_and_verify(const struct sctimer_case *c);

/** Print what this build covers, once, from the suite setup. */
void sctimer_report_configuration(void);

/** Print the gate and the register image, labelled, without asserting anything. */
void sctimer_report_hw(const struct sctimer_case *c, const char *when);

#endif /* ZEPHYR_TESTS_SCTIMER_SCTIMER_H_ */
```

## src/test_control.c
```c
/*
 * Copyright 2026 NXP
 * SPDX-License-Identifier: Apache-2.0
 */

/**
 * @file
 * @brief The control: this case really does drive the SCTimer.
 *
 * Compiled into every layer. If this fails, no verdict from the layer under test
 * means anything.
 *
 * Three claims: that a configured channel leaves a register image distinguishable
 * from a reset block, that the counter counts, and that the output toggles. Every
 * later layer tells "restored" from "came back from reset" by comparing against that
 * image, and tells a restored block from one that reads back right but is not driving
 * anything by watching the output.
 */

#include <zephyr/pm/device_runtime.h>
#include <zephyr/ztest.h>

#include "sctimer.h"

ZTEST(sctimer_pm, test_control_drives_the_output)
{
	SCTIMER_FOREACH_CASE(c) {
		struct sctimer_image configured;
		bool held = false;
		bool counting;
		bool toggling;
		int rc;

		/*
		 * Under runtime PM the device boots suspended and this driver takes no
		 * reference of its own, so the control has to ask for it. That an
		 * unwrapped call is refused is test_runtime.c's claim, not a premise
		 * of the control.
		 */
		if (pm_device_runtime_is_enabled(c->dev)) {
			zassert_ok(pm_device_runtime_get(c->dev),
				   "%s: could not resume the device for the control",
				   c->dev->name);
			held = true;
		}

		rc = sctimer_configure(c);
		sctimer_image_read(c, &configured);
		counting = sctimer_advances(c);
		toggling = sctimer_output_toggles(c);
		sctimer_report_hw(c, "control");

		if (held) {
			/* Before the assertions: a failure must not leak the reference. */
			(void)pm_device_runtime_put(c->dev);
		}

		zassert_ok(rc, "%s: pwm_set_cycles() failed (%d)", c->dev->name, rc);

		/*
		 * The prescaler this driver writes from devicetree is 0 on every board
		 * here, which is also what a reset leaves -- so the match reloads and
		 * the output events are the only register state in this block that a
		 * restore can be seen to put back.
		 */
		zassert_false(sctimer_image_is_clear(&configured),
			      "%s: a configured channel left the registers at reset",
			      c->dev->name);
		zassert_true(counting, "%s: the counter is not counting", c->dev->name);
		zassert_true(toggling, "%s: the output is not toggling", c->dev->name);
	}
}
```

## src/test_device.c
```c
/*
 * Copyright 2026 NXP
 * SPDX-License-Identifier: Apache-2.0
 */

/**
 * @file
 * @brief The device layer: the driver's PM callbacks, driven directly.
 *
 * Two tests, for the two halves of the callback. The first is the SUSPEND/RESUME
 * round trip, which owns the clock gate and the park. The second is TURN_OFF/TURN_ON,
 * which owns the register block -- and since nothing in this layer really cut power
 * to it, the block is clobbered by hand so that the replay has something to put back.
 * What a real power cycle does is asked in src/test_lowpower.c under the dpd layer.
 *
 * Note which action is expected to bring the block up. TURN_ON rebuilds the register
 * block and replays the channel the consumer had configured, borrowing the clock to
 * do it and handing it back before it returns, so an instance which boots SUSPENDED
 * under runtime PM boots configured but genuinely gated and not driving. RESUME
 * re-opens the gate and restarts the counter. The tests assert that split: a gated
 * SCT register does not answer, so the block is read by borrowing the clock back --
 * see sctimer_peek_gated() -- after the gate itself has been sampled.
 *
 * What a suspend owes the consumer: the channel programming stays in the registers,
 * the counter is halted, and the output is held at its inactive level rather than
 * frozen wherever the counter happened to stop. A resume restarts the counter the
 * consumer was running, without the consumer asking again -- see src/sctimer.h for
 * the contract.
 */

#include <zephyr/pm/device.h>
#include <zephyr/ztest.h>

#include <pm_test/state.h>

#include "sctimer.h"

ZTEST(sctimer_pm, test_device_suspend_resume)
{
	SCTIMER_FOREACH_CASE(c) {
		struct sctimer_image configured;
		struct sctimer_image after;
		struct sctimer_peek parked;
		bool gate_after_suspend;
		int err;

		if (!sctimer_gate_observable(c)) {
			TC_PRINT("%s: clock gate not observable, nothing asserted\n",
				 c->dev->name);
			continue;
		}

		/* No runtime PM in this layer, so pm_device_driver_init() resumed it. */
		zassert_pm_state(c->dev, PM_DEVICE_STATE_ACTIVE);
		zassert_true(sctimer_gate_is_open(c), "%s: gate closed while PM reports ACTIVE",
			     c->dev->name);

		zassert_ok(sctimer_configure(c), "%s: pwm_set_cycles() failed", c->dev->name);
		sctimer_image_read(c, &configured);
		zassert_true(sctimer_output_toggles(c), "%s: the output is not toggling before "
			     "the suspend", c->dev->name);
		sctimer_report_hw(c, "before-suspend");

		zassert_ok(pm_device_action_run(c->dev, PM_DEVICE_ACTION_SUSPEND),
			   "%s: SUSPEND action rejected", c->dev->name);
		zassert_pm_state(c->dev, PM_DEVICE_STATE_SUSPENDED);

		/*
		 * The gate is sampled first and on its own: an unclocked block does not
		 * answer, and reading it to find out whether it is clocked is the one
		 * thing that cannot be done. Only then is the clock borrowed back to see
		 * what the suspend left in the registers.
		 */
		gate_after_suspend = sctimer_gate_is_open(c);
		sctimer_peek_gated(c, &parked);
		sctimer_report_hw(c, "after-suspend");

		zassert_false(gate_after_suspend, "%s: clock gate still open after SUSPEND",
			      c->dev->name);

		/* The park: halted, held inactive, and still programmed. */
		zassert_false(parked.running, "%s: the counter is still running after SUSPEND",
			      c->dev->name);
		zassert_false(parked.output_high,
			      "%s: SUSPEND left the output high, not at its inactive level",
			      c->dev->name);
		zassert_true(sctimer_image_equal(&parked.image, &configured),
			     "%s: SUSPEND destroyed the channel configuration: MATCHREL0=0x%08x "
			     "MATCHREL1=0x%08x SET=0x%08x CLR=0x%08x, want 0x%08x/0x%08x/0x%08x/"
			     "0x%08x", c->dev->name, parked.image.matchrel_period,
			     parked.image.matchrel_pulse, parked.image.out_set,
			     parked.image.out_clr, configured.matchrel_period,
			     configured.matchrel_pulse, configured.out_set, configured.out_clr);

		zassert_ok(pm_device_action_run(c->dev, PM_DEVICE_ACTION_RESUME),
			   "%s: RESUME action rejected", c->dev->name);
		zassert_pm_state(c->dev, PM_DEVICE_STATE_ACTIVE);
		sctimer_image_read(c, &after);
		sctimer_report_hw(c, "after-resume");

		zassert_true(sctimer_gate_is_open(c), "%s: gate still closed after RESUME",
			     c->dev->name);

		/*
		 * The channel the consumer configured is driving again, and the consumer
		 * did nothing to make that happen.
		 */
		zassert_true(sctimer_image_equal(&after, &configured),
			     "%s: RESUME left MATCHREL0=0x%08x MATCHREL1=0x%08x SET=0x%08x "
			     "CLR=0x%08x, want 0x%08x/0x%08x/0x%08x/0x%08x", c->dev->name,
			     after.matchrel_period, after.matchrel_pulse, after.out_set,
			     after.out_clr, configured.matchrel_period, configured.matchrel_pulse,
			     configured.out_set, configured.out_clr);
		zassert_true(sctimer_advances(c), "%s: the counter is not running after RESUME",
			     c->dev->name);
		zassert_true(sctimer_output_toggles(c), "%s: the output is not toggling after "
			     "RESUME", c->dev->name);

		/* A redundant action must be refused, not obeyed and not fatal. */
		err = pm_device_action_run(c->dev, PM_DEVICE_ACTION_RESUME);
		zassert_equal(err, -EALREADY, "%s: second RESUME returned %d, want -EALREADY",
			      c->dev->name, err);
	}
}

ZTEST(sctimer_pm, test_device_turn_on_replays_the_channel)
{
	SCTIMER_FOREACH_CASE(c) {
		struct sctimer_image configured;
		struct sctimer_image clobbered;
		struct sctimer_image after_resume;
		struct sctimer_peek after_turn_on;
		bool gate_after_turn_on;
		int suspend_rc;
		int turn_off_rc;
		int turn_on_rc;
		int resume_rc;

		if (!sctimer_gate_observable(c)) {
			TC_PRINT("%s: clock gate not observable, nothing asserted\n",
				 c->dev->name);
			continue;
		}

		zassert_pm_state(c->dev, PM_DEVICE_STATE_ACTIVE);
		zassert_ok(sctimer_configure(c), "%s: pwm_set_cycles() failed", c->dev->name);
		sctimer_image_read(c, &configured);

		/*
		 * Collected in one go and asserted afterwards, so that a failure cannot
		 * hand the next test a device the core still records as OFF.
		 */
		suspend_rc = pm_device_action_run(c->dev, PM_DEVICE_ACTION_SUSPEND);

		sctimer_clobber(c, &clobbered);

		turn_off_rc = pm_device_action_run(c->dev, PM_DEVICE_ACTION_TURN_OFF);

		turn_on_rc = pm_device_action_run(c->dev, PM_DEVICE_ACTION_TURN_ON);
		gate_after_turn_on = sctimer_gate_is_open(c);
		sctimer_peek_gated(c, &after_turn_on);

		resume_rc = pm_device_action_run(c->dev, PM_DEVICE_ACTION_RESUME);
		sctimer_image_read(c, &after_resume);
		sctimer_report_hw(c, "after-resume");

		zassert_ok(suspend_rc, "%s: SUSPEND rejected (%d)", c->dev->name, suspend_rc);
		zassert_ok(turn_off_rc, "%s: TURN_OFF rejected (%d)", c->dev->name, turn_off_rc);
		zassert_ok(turn_on_rc, "%s: TURN_ON rejected (%d)", c->dev->name, turn_on_rc);
		zassert_ok(resume_rc, "%s: RESUME rejected (%d)", c->dev->name, resume_rc);
		zassert_pm_state(c->dev, PM_DEVICE_STATE_ACTIVE);

		/* Before anything else: a clobber that did not take would make the claims
		 * below answerable without the block ever having been disturbed.
		 */
		zassert_true(sctimer_image_is_clear(&clobbered), "%s: the clobber did not take",
			     c->dev->name);

		/*
		 * TURN_ON returns with the core about to record the device as suspended,
		 * so a block left clocked, or left counting, would be a block running
		 * behind a PM state that says it is not.
		 */
		zassert_false(gate_after_turn_on, "%s: TURN_ON opened the clock gate",
			      c->dev->name);
		zassert_false(after_turn_on.running, "%s: TURN_ON left the counter running",
			      c->dev->name);
		zassert_false(after_turn_on.output_high,
			      "%s: TURN_ON left the output high, not at its inactive level",
			      c->dev->name);

		/*
		 * And the replay is TURN_ON's, not RESUME's: what the consumer configured
		 * is back in the registers before the device is resumed, because a power
		 * domain cycle is the case this exists for and nothing re-runs init there.
		 */
		zassert_true(sctimer_image_equal(&after_turn_on.image, &configured),
			     "%s: TURN_ON did not replay the channel: MATCHREL0=0x%08x "
			     "MATCHREL1=0x%08x SET=0x%08x CLR=0x%08x, want 0x%08x/0x%08x/"
			     "0x%08x/0x%08x", c->dev->name, after_turn_on.image.matchrel_period,
			     after_turn_on.image.matchrel_pulse, after_turn_on.image.out_set,
			     after_turn_on.image.out_clr, configured.matchrel_period,
			     configured.matchrel_pulse, configured.out_set, configured.out_clr);

		zassert_true(sctimer_gate_is_open(c), "%s: RESUME left the clock gate closed",
			     c->dev->name);
		zassert_true(sctimer_image_equal(&after_resume, &configured),
			     "%s: the round trip did not restore the channel", c->dev->name);

		/* And the block has to drive, not just read back right. */
		zassert_true(sctimer_advances(c),
			     "%s: the counter is not running after the round trip",
			     c->dev->name);
		zassert_true(sctimer_output_toggles(c),
			     "%s: the output is not toggling after the round trip",
			     c->dev->name);

		/* Reconfiguring still works on the rebuilt block. */
		zassert_ok(sctimer_configure(c),
			   "%s: the channel cannot be reconfigured after the round trip",
			   c->dev->name);
	}
}
```

## src/test_lowpower.c
```c
/*
 * Copyright 2026 NXP
 * SPDX-License-Identifier: Apache-2.0
 */

/**
 * @file
 * @brief The sysmanaged and dpd layers: the device sweep across one transition.
 *
 * One file for two layers, because the sequence is identical and only the state being
 * entered differs. In sysmanaged the sweep's SUSPEND and RESUME are all that happen,
 * so the block keeps its power and re-opening the clock gate is enough to put the
 * output back. In dpd the CORE domain is power gated: the whole register block comes
 * back at its reset value, the SYSCON clock gate with it, and nothing re-runs driver
 * init -- so TURN_ON has to rebuild the block from the devicetree and replay the
 * channel the consumer configured.
 *
 * Which means the register image cannot tell the two apart: this driver replays, so a
 * restored image is what both layers owe. The discriminator is a witness value
 * written into a match reload register the driver never touches (see
 * sctimer_witness_write()): it survives a suspend and is gone after a power cycle.
 * That is also what keeps the dpd verdict honest -- without it, a block that quietly
 * kept its power would pass as a block that was rebuilt.
 *
 * What is asserted after the transition is behavioural as well as register-level:
 * that the output is really toggling. An SCTimer's counter runs off the bus clock,
 * which the board selects and this driver does not, so a register image that came
 * back perfectly while the clock did not would look restored and still drive nothing.
 */

#include <zephyr/pm/device.h>
#include <zephyr/ztest.h>

#include <pm_test/lowpower.h>
#include <pm_test/state.h>

#include "sctimer.h"

ZTEST(sctimer_pm, test_sweep_across_transition)
{
	SCTIMER_FOREACH_CASE(c) {
		struct sctimer_image configured;
		struct sctimer_image after;
		bool gate_after;
		bool witness_after = false;

		/* No runtime PM in these layers, so the sweep is the only thing that will
		 * suspend the device.
		 */
		zassert_pm_state(c->dev, PM_DEVICE_STATE_ACTIVE);

		zassert_ok(sctimer_configure(c), "%s: pwm_set_cycles() failed before the "
			   "transition", c->dev->name);
		zassert_true(sctimer_output_toggles(c),
			     "%s: the output is not toggling before the transition",
			     c->dev->name);

		sctimer_witness_write(c);
		sctimer_image_read(c, &configured);
		sctimer_report_hw(c, "before");

		pm_test_enter_transition();

		/* Sampled before the console is revived: reviving it takes time, and the
		 * question is what the block looked like the moment the sweep handed it
		 * back.
		 */
		gate_after = sctimer_gate_is_open(c);
		if (gate_after) {
			sctimer_image_read(c, &after);
			witness_after = sctimer_witness_survives(c);
		}

		pm_test_console_resume(PM_TEST_CONSOLE_REINIT_PINMUX);
		TC_PRINT("resumed from %s\n", PM_TEST_TRANSITION_NAME);
		sctimer_report_hw(c, "after-resume");

		zassert_pm_state(c->dev, PM_DEVICE_STATE_ACTIVE);

		if (!sctimer_gate_observable(c)) {
			TC_PRINT("%s: clock gate not observable, register claims skipped\n",
				 c->dev->name);
		} else {
			/*
			 * The gate first: without it the register comparisons below would
			 * be reading an unclocked block, and "restored" would be whatever
			 * the bus returns.
			 */
			zassert_true(gate_after,
				     "%s: the clock gate was not re-opened across the "
				     "transition", c->dev->name);

			/* Both layers owe the channel back, by different routes. */
			zassert_true(sctimer_image_equal(&after, &configured),
				     "%s: the channel did not come back across %s: "
				     "MATCHREL0=0x%08x MATCHREL1=0x%08x SET=0x%08x "
				     "CLR=0x%08x, want 0x%08x/0x%08x/0x%08x/0x%08x",
				     c->dev->name, PM_TEST_TRANSITION_NAME,
				     after.matchrel_period, after.matchrel_pulse,
				     after.out_set, after.out_clr, configured.matchrel_period,
				     configured.matchrel_pulse, configured.out_set,
				     configured.out_clr);

#if defined(CONFIG_PM_TEST_LAYER_DPD)
			/*
			 * And the witness says the image above is a replay and not a block
			 * that was never disturbed.
			 */
			zassert_false(witness_after,
				      "%s: the witness survived %s, so the block kept its "
				      "power and TURN_ON was never asked to rebuild it",
				      c->dev->name, PM_TEST_TRANSITION_NAME);
#else
			zassert_true(witness_after,
				     "%s: the witness is gone after %s, so the block lost "
				     "power in a state that was supposed to keep it",
				     c->dev->name, PM_TEST_TRANSITION_NAME);
#endif
		}

		/* And the block has to drive, not just read back right. */
		zassert_true(sctimer_output_toggles(c),
			     "%s: the output is not toggling after %s", c->dev->name,
			     PM_TEST_TRANSITION_NAME);
	}
}
```

## src/test_runtime.c
```c
/*
 * Copyright 2026 NXP
 * SPDX-License-Identifier: Apache-2.0
 */

/**
 * @file
 * @brief The runtime layer: the consumer owns the output, and says so with a
 *        reference.
 *
 * This driver takes no runtime PM reference of its own. A PWM output drives until the
 * consumer changes it, and there is no completion event a put() could hang on, so
 * wrapping each API call in its own get/put would stop the output the moment the call
 * returned. The reference is the consumer's -- and because it is, a call that arrives
 * while nobody holds one cannot reach the peripheral and is refused rather than
 * silently writing a register behind a closed clock gate.
 *
 * What this layer also catches is the boot state. pm_device_driver_init() runs TURN_ON
 * and then stops short of RESUME when runtime PM is about to own the device, so a
 * driver that leaves the block clocked in TURN_ON boots it running while the core
 * records it as SUSPENDED. This driver's TURN_ON configures the block, parks it and
 * gates it again before returning, and the first test below is the check.
 *
 * Three tests. The first has to run first: it reads the state the device booted in,
 * and the others leave it suspended.
 */

#include <zephyr/pm/device.h>
#include <zephyr/pm/device_runtime.h>
#include <zephyr/ztest.h>

#include <pm_test/state.h>

#include "sctimer.h"

ZTEST(sctimer_pm, test_runtime_boots_without_a_consumer)
{
	SCTIMER_FOREACH_CASE(c) {
		enum pm_device_state state;

		zassert_true(pm_device_runtime_is_enabled(c->dev),
			     "%s: runtime PM is not enabled on this device", c->dev->name);

		/*
		 * Two boot states are legal. Without a power domain the device lands in
		 * SUSPENDED; with one it lands in OFF, because the domain is
		 * runtime-suspended before the SCTimer initialises and TURN_ON was
		 * skipped -- pd-soc-state-change-no-turn-on-under-runtime-pm in
		 * docs/findings.md.
		 */
		zassert_ok(pm_device_state_get(c->dev, &state),
			   "%s: pm_device_state_get() failed", c->dev->name);
		zassert_true((state == PM_DEVICE_STATE_SUSPENDED) ||
				     (state == PM_DEVICE_STATE_OFF),
			     "%s booted %s, want SUSPENDED or OFF under runtime PM",
			     c->dev->name, pm_device_state_str(state));

		if (!sctimer_gate_observable(c)) {
			TC_PRINT("%s: clock gate not observable, nothing asserted\n",
				 c->dev->name);
			continue;
		}

		/* The claim. Nothing may be clocked before a consumer has asked for it. */
		zassert_false(sctimer_gate_is_open(c),
			      "%s: clock gate open before any consumer took a reference",
			      c->dev->name);
	}
}

ZTEST(sctimer_pm, test_runtime_api_refuses_a_suspended_device)
{
	SCTIMER_FOREACH_CASE(c) {
		struct sctimer_peek before;
		struct sctimer_peek after;
		int err;

		zassert_pm_state(c->dev, PM_DEVICE_STATE_SUSPENDED);

		/*
		 * What the registers hold before the refused call, so the refusal can be
		 * shown to have been a refusal and not a write that happened to fail.
		 */
		sctimer_peek_gated(c, &before);

		err = sctimer_configure(c);

		sctimer_peek_gated(c, &after);

		zassert_equal(err, -EBUSY,
			      "%s: pwm_set_cycles() on a suspended device returned %d, want "
			      "-EBUSY", c->dev->name, err);
		zassert_pm_state(c->dev, PM_DEVICE_STATE_SUSPENDED);

		if (sctimer_gate_observable(c)) {
			zassert_false(sctimer_gate_is_open(c),
				      "%s: the refused call left the clock gate open",
				      c->dev->name);
		}

		zassert_true(sctimer_image_equal(&after.image, &before.image),
			     "%s: the refused call changed the registers", c->dev->name);
		zassert_false(after.running, "%s: the refused call started the counter",
			      c->dev->name);
	}
}

ZTEST(sctimer_pm, test_runtime_reference_counting)
{
	SCTIMER_FOREACH_CASE(c) {
		struct sctimer_image configured;
		struct sctimer_image after;

		zassert_ok(pm_device_runtime_get(c->dev), "%s: runtime_get rejected",
			   c->dev->name);
		zassert_pm_state(c->dev, PM_DEVICE_STATE_ACTIVE);

		if (sctimer_gate_observable(c)) {
			zassert_true(sctimer_gate_is_open(c),
				     "%s: gate closed while PM reports ACTIVE", c->dev->name);
		}

		zassert_ok(sctimer_configure(c), "%s: pwm_set_cycles() failed under a held "
			   "reference", c->dev->name);
		sctimer_image_read(c, &configured);
		zassert_true(sctimer_output_toggles(c), "%s: the output is not toggling under a "
			     "held reference", c->dev->name);

		/* A second reference must not be a second resume, and releasing it must not
		 * stop an output somebody else is still holding.
		 */
		zassert_ok(pm_device_runtime_get(c->dev), "%s: nested runtime_get rejected",
			   c->dev->name);
		zassert_ok(pm_device_runtime_put(c->dev), "%s: first runtime_put rejected",
			   c->dev->name);
		zassert_pm_state(c->dev, PM_DEVICE_STATE_ACTIVE);
		zassert_true(sctimer_advances(c), "%s: counter stopped while a reference was held",
			     c->dev->name);

		zassert_ok(pm_device_runtime_put(c->dev), "%s: last runtime_put rejected",
			   c->dev->name);
		zassert_pm_state(c->dev, PM_DEVICE_STATE_SUSPENDED);
		sctimer_report_hw(c, "after-put");

		if (sctimer_gate_observable(c)) {
			zassert_false(sctimer_gate_is_open(c),
				      "%s: clock gate still open after the last runtime_put",
				      c->dev->name);
		}

		/*
		 * And the consumer gets its output back by taking the reference again,
		 * without reconfiguring: what it programmed is the driver's to remember
		 * across a suspend the consumer did not ask for.
		 */
		zassert_ok(pm_device_runtime_get(c->dev),
			   "%s: runtime_get after the put rejected", c->dev->name);
		sctimer_image_read(c, &after);
		sctimer_report_hw(c, "after-reget");

		zassert_true(sctimer_image_equal(&after, &configured),
			     "%s: the channel did not come back with the reference: "
			     "MATCHREL0=0x%08x MATCHREL1=0x%08x SET=0x%08x CLR=0x%08x, want "
			     "0x%08x/0x%08x/0x%08x/0x%08x", c->dev->name, after.matchrel_period,
			     after.matchrel_pulse, after.out_set, after.out_clr,
			     configured.matchrel_period, configured.matchrel_pulse,
			     configured.out_set, configured.out_clr);
		zassert_true(sctimer_output_toggles(c),
			     "%s: the output is not toggling after the counter came back",
			     c->dev->name);

		/* Left as it was found, so this test's output does not outlive it. */
		zassert_ok(pm_device_runtime_put(c->dev), "%s: final runtime_put rejected",
			   c->dev->name);
	}
}
```

## src/test_system.c
```c
/*
 * Copyright 2026 NXP
 * SPDX-License-Identifier: Apache-2.0
 */

/**
 * @file
 * @brief The system layer: the per-device power state constraint.
 *
 * The SCTimer node lists the states that stop it counting in
 * zephyr,disabling-power-states (see constraints.overlay), and the driver holds a
 * policy constraint against exactly those states for as long as a channel is driving
 * an output and the device is active. The window is not one API call -- a PWM output
 * has no completion event -- so the constraint follows the output and the device
 * state together: a runtime-PM suspend that parks the output hands the lock back, and
 * a resume that restarts the counter takes it again. Without that, one
 * pwm_set_cycles() would block those states for the rest of the run even with no
 * consumer left holding a reference.
 *
 * Two tests: that the lock matches what the node declares and is gone once the last
 * reference is dropped, and that it follows the output across a suspend and a resume
 * rather than being taken once and kept.
 */

#include <zephyr/pm/device_runtime.h>
#include <zephyr/pm/policy.h>
#include <zephyr/pm/state.h>
#include <zephyr/ztest.h>

#include <pm_test/lowpower.h>

#include "sctimer.h"

/* How many power states are locked right now, by anyone. */
static unsigned int locked_states(void)
{
	unsigned int locked = 0;

	for (enum pm_state state = PM_STATE_ACTIVE; state < PM_STATE_COUNT; state++) {
		locked += pm_policy_state_lock_is_active(state, 0) ? 1U : 0U;
	}

	return locked;
}

/*
 * How many power states this node declares as disabling. States that are listed but
 * disabled in the devicetree are dropped from the generated table, so this can
 * legitimately be smaller than the list in constraints.overlay. A zero means the
 * overlay never reached the node, which is why the tests below guard on it.
 */
static unsigned int declared_states(const struct device *dev)
{
	unsigned int declared = 0;

	for (enum pm_state state = PM_STATE_ACTIVE; state < PM_STATE_COUNT; state++) {
		declared += pm_policy_device_is_disabling_state(dev, state, 0) ? 1U : 0U;
	}

	return declared;
}

/* Locked states that the node does not declare, or declared states left unlocked. */
static unsigned int constraint_mismatch(const struct device *dev)
{
	unsigned int mismatch = 0;

	for (enum pm_state state = PM_STATE_ACTIVE; state < PM_STATE_COUNT; state++) {
		bool locked = pm_policy_state_lock_is_active(state, 0);
		bool disabling = pm_policy_device_is_disabling_state(dev, state, 0);

		mismatch += (locked != disabling) ? 1U : 0U;
	}

	return mismatch;
}

ZTEST(sctimer_pm, test_system_constraint_covers_the_declared_states)
{
	SCTIMER_FOREACH_CASE(c) {
		unsigned int before;
		unsigned int while_driving;
		unsigned int declared;
		unsigned int mismatch;
		unsigned int after_put;
		int configure_rc;

		declared = declared_states(c->dev);
		if (declared == 0U) {
			/* No state is declared to stop this instance, so there is no
			 * constraint to observe. Said rather than passed quietly.
			 */
			TC_PRINT("%s: declares no disabling power state, nothing asserted\n",
				 c->dev->name);
			continue;
		}

		pm_test_console_quiesce();
		before = locked_states();

		zassert_ok(pm_device_runtime_get(c->dev), "%s: runtime_get rejected",
			   c->dev->name);

		configure_rc = sctimer_configure(c);
		while_driving = locked_states();
		mismatch = constraint_mismatch(c->dev);

		/* Released before anything is asserted: a failure must not leave a lock
		 * behind, which would silently block those states for the rest of the run.
		 */
		(void)pm_device_runtime_put(c->dev);

		pm_test_console_quiesce();
		after_put = locked_states();

		zassert_equal(before, 0U, "%s: %u power state(s) were already locked",
			      c->dev->name, before);
		zassert_ok(configure_rc, "%s: pwm_set_cycles() failed (%d)", c->dev->name,
			   configure_rc);

		zassert_equal(while_driving, declared,
			      "%s: %u state(s) locked while driving an output, %u declared",
			      c->dev->name, while_driving, declared);
		zassert_equal(mismatch, 0U,
			      "%s: %u power state(s) whose lock does not match the node",
			      c->dev->name, mismatch);
		zassert_equal(after_put, 0U,
			      "%s: %u power state(s) still locked after the last reference went "
			      "away", c->dev->name, after_put);
	}
}

ZTEST(sctimer_pm, test_system_constraint_follows_the_output)
{
	SCTIMER_FOREACH_CASE(c) {
		unsigned int declared;
		unsigned int while_driving;
		unsigned int while_suspended;
		unsigned int after_resume;
		unsigned int at_end;
		int configure_rc;
		bool toggling_after_resume;

		declared = declared_states(c->dev);
		if (declared == 0U) {
			TC_PRINT("%s: declares no disabling power state, nothing asserted\n",
				 c->dev->name);
			continue;
		}

		pm_test_console_quiesce();

		zassert_ok(pm_device_runtime_get(c->dev), "%s: runtime_get rejected",
			   c->dev->name);
		configure_rc = sctimer_configure(c);
		while_driving = locked_states();

		/* The last reference goes away, so the driver suspends and the output is
		 * parked -- and with it the reason for the lock.
		 */
		(void)pm_device_runtime_put(c->dev);
		pm_test_console_quiesce();
		while_suspended = locked_states();

		/*
		 * A resume restarts the output the consumer was driving, so it has to
		 * take the protection back: without it the output comes back driving
		 * while the policy is free to enter a state that stops its clock.
		 */
		zassert_ok(pm_device_runtime_get(c->dev), "%s: second runtime_get rejected",
			   c->dev->name);
		toggling_after_resume = sctimer_output_toggles(c);
		after_resume = locked_states();

		(void)pm_device_runtime_put(c->dev);
		pm_test_console_quiesce();
		at_end = locked_states();

		zassert_ok(configure_rc, "%s: pwm_set_cycles() failed (%d)", c->dev->name,
			   configure_rc);
		zassert_equal(while_driving, declared,
			      "%s: %u state(s) locked while driving an output, %u declared",
			      c->dev->name, while_driving, declared);
		zassert_equal(while_suspended, 0U,
			      "%s: %u power state(s) still locked while suspended", c->dev->name,
			      while_suspended);
		zassert_true(toggling_after_resume,
			     "%s: the output is not toggling after the resume", c->dev->name);
		zassert_equal(after_resume, declared,
			      "%s: %u state(s) locked after the output came back, %u declared",
			      c->dev->name, after_resume, declared);
		zassert_equal(at_end, 0U, "%s: %u power state(s) leaked past the end of the test",
			      c->dev->name, at_end);
	}
}
```
