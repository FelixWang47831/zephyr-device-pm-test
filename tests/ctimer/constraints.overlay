/*
 * Copyright 2026 NXP
 * SPDX-License-Identifier: Apache-2.0
 *
 * System-PM constraint layer: mark which SoC power states stop this CTIMER
 * counting. Stacked on top of whatever the board target already applies, for the
 * system layer only (via EXTRA_DTC_OVERLAY_FILE).
 *
 * The MCX Nx4x SoC dtsi declares this list for all five of its CTIMER instances, so
 * on those targets this restates what is already there. It is what supplies the list
 * on the MCXN23x and MCXA targets in platform_allow, whose SoC dtsi does not declare
 * it.
 *
 * Why all three states. Per MCX Nx4x RM Rev. 6_RC2 Table 336, CTIMER0 is "LP/Static"
 * in both Deep Sleep and Power Down and CTIMER1-3 are "LP/Static" in Deep Sleep --
 * that is, the block *can* keep counting in those states, but only on a functional
 * clock that survives them. The MCXN and MCXA boards this case runs on all attach
 * PLL0 (or the equivalent system PLL) to their CTIMER, and that PLL is off in Deep
 * Sleep, so on these boards every one of the three states does stop the counter.
 *
 * Deep Power Down additionally gates the CORE domain and resets the registers, which
 * is the stronger loss the dpd layer is about.
 */

&ctimer0 {
	zephyr,disabling-power-states = <&deepsleep &powerdown &deeppowerdown>;
};
